## Kconfig
```kconfig
menuconfig AZ1UBALL
  bool "Palette-System AZ1UBALL Trackball Support"
  select ZMK_POINTING
  select I2C
  help
    Enable driver for Palette-System AZ1UBALL Trackball.

if AZ1UBALL
  module = AZ1UBALL
  module-str = AZ1UBALL
  source "${ZEPHYR_BASE}/subsys/logging/Kconfig.template.log_config"
endif #AZ1UBALL
```

## dts/bindings/palette,az1uball.yml
```yaml
description: AZ1UBALL trackball sensor

compatible: "palette,az1uball"

include: i2c-device.yaml

properties:
  reg:
    required: true
    description: I2C address of the trackball
```
